## app/src/modules/environmental/Kconfig.environmental
```kconfig
#
# Copyright (c) 2024 Nordic Semiconductor
#
# SPDX-License-Identifier: LicenseRef-Nordic-5-Clause
#

menuconfig APP_ENVIRONMENTAL
	bool "Environmental module"
	depends on BME680
	default y

if APP_ENVIRONMENTAL

config APP_ENVIRONMENTAL_THREAD_STACK_SIZE
	int "Thread stack size"
	default 1024

config APP_ENVIRONMENTAL_WATCHDOG_TIMEOUT_SECONDS
	int "Watchdog timeout"
	default 120
	help
	  Timeout in seconds for the environmental module watchdog.
	  The timeout given in this option covers both:
	    * Waiting for an incoming message in zbus_sub_wait_msg().
	    * Time spent processing the message, defined by
	      CONFIG_APP_ENVIRONMENTAL_MSG_PROCESSING_TIMEOUT_SECONDS.
	  Ensure that this value exceeds CONFIG_APP_ENVIRONMENTAL_MSG_PROCESSING_TIMEOUT_SECONDS.
	  A small difference between the two can mean more frequent watchdog feeds, which increases
	  power consumption.

config APP_ENVIRONMENTAL_MSG_PROCESSING_TIMEOUT_SECONDS
	int "Maximum message processing time"
	default 3
	help
	  Maximum time allowed for processing a single message in the module's state machine.
	  The value must be smaller than CONFIG_APP_ENVIRONMENTAL_WATCHDOG_TIMEOUT_SECONDS.

config APP_ENVIRONMENTAL_IMU_SAMPLING_FREQUENCY_HZ
	int "IMU sampling frequency (Hz)"
	default 50
	range 1 200
	help
	  Sampling frequency for the BMI270 (accelerometer/gyroscope) and ADXL367
	  (low-power accelerometer) sensors in Hz. The sampling period in milliseconds
	  is calculated as 1000/frequency.
	  
	  Supported values:
	  - 50 Hz (20 ms): Default, good balance between data rate and power consumption
	  - Other values: Depends on sensor configuration

config APP_ENVIRONMENTAL_RING_BUFFER_SIZE
	int "IMU ring buffer size (bytes)"
	default 2048
	range 512 4096
	help
	  Size of the ring buffer used to store sensor samples from BMI270 and ADXL367.
	  This uses Zephyr's sys/ring_buffer.h (not K_FIFO).
	  Each sample is approximately 64 bytes, so:
	  - 512 bytes: ~8 samples
	  - 1024 bytes: ~16 samples
	  - 2048 bytes: ~32 samples (default, recommended)
	  - 4096 bytes: ~64 samples
	  
	  Larger buffers reduce sample loss at the cost of more memory usage.

config APP_ENVIRONMENTAL_STARTUP_DELAY_SECONDS
	int "Startup delay before sampling begins (seconds)"
	default 0
	help
	  Delay in seconds before the environmental module starts collecting sensor data.
	  Set to 0 for immediate start (default).
	  Use this to stagger multiple devices so they start sampling at different times.
	  Example: Set device A to 0, device B to 24 hours, so device B starts when device A fills up storage.

module = APP_ENVIRONMENTAL
module-str = ENVIRONMENTAL
source "subsys/logging/Kconfig.template.log_config"

endif # APP_ENVIRONMENTAL
```
